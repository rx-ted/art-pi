## Kconfig
```kconfig
mainmenu "RT-Thread Configuration"

config BSP_DIR  
    string
    option env="BSP_ROOT"
    default "."

# local path see rt-thread current postion
config RTT_DIR
    string
    option env="RTT_ROOT"
    default "./rt-thread"

config PKGS_DIR
    string
    option env="PKGS_ROOT"
    default "./packages"

source "$RTT_DIR/Kconfig"
source "$PKGS_DIR/Kconfig"
source "$BSP_DIR/libraries/Kconfig"
# source "$BSP_DIR/application/tft/Kconfig"
# if $RTT_DIR
#     source "$RTT_DIR/Kconfig"
# endif
# if $PKGS_DIR
#     source "$PKGS_DIR/Kconfig"
# endif

config RT_STUDIO_BUILT_IN
    bool
    select ARCH_ARM_CORTEX_M7
    select RT_USING_COMPONENTS_INIT
    select RT_USING_USER_MAIN
    default y
```

## application/lvgl/Kconfig
```kconfig
menu "lvgl configuration"
    if PKG_USING_LVGL
    config PKG_USING_LVGL_DISP
    bool "In use LVGL, start up display"

    config PKG_USING_LVGL_INDEV
    bool "In use LVGL, start up touch"

    config PKG_USING_LVGL_GUI
    bool "In use LVGL, start up the example GUI"
    
    config PKG_USING_LVGL_DMA2D
    bool "Use DMA2D when run LVGL"
    
    
    endif

    
    
endmenu
```

## projects/4dma_lvgl/applications/tft/Kconfig
```kconfig
menu "tft library"

    config DRIVER_USING_R61581
    bool "DRIVER USING R61581"
    config DRIVER_USING_ILI9341
    bool "DRIVER USING ILI9341"
    
endmenu
```
